## boards/kabot_esp32s3/Kconfig.kabot
```kconfig
config BOARD_KABOT
    select SOC_ESP32S3_WROOM_N16R8
    select SOC_ESP32S3_PROCPU
```

## boards/kabot_esp32s3/board.yml
```yaml
board:
    name: kabot
    vendor: kabot
    full_name: Kabot main board
    socs:
        - name: esp32s3
```

## boards/kabot_esp32s3/kabot_esp32s3_procpu_defconfig
```kconfig
# SPDX-License-Identifier: Apache-2.0

CONFIG_CONSOLE=y
CONFIG_SERIAL=y
CONFIG_UART_CONSOLE=y
CONFIG_GPIO=y
CONFIG_CLOCK_CONTROL=y

CONFIG_HEAP_MEM_POOL_SIZE=16384
CONFIG_BUILD_OUTPUT_HEX=y

CONFIG_ESP_SPIRAM=y
```

## modules/led_strip/Kconfig
```kconfig
menu "LED Strip Module"

config KABOT_LED_STRIP_SHELL
    bool "Enable LED strip shell commands"
    default y
    depends on SHELL
    help
      Enable the `led_strip` shell command group (e.g. `led_strip set <N> <R> <G> <B>`).

endmenu
```

## modules/motor_driver/Kconfig
```kconfig
menuconfig MOTOR_DRIVER_MODULE
    bool "Enable motor driver module"
    default y
    help
      Enables the custom motor driver module.

if MOTOR_DRIVER_MODULE

config KABOT_ESC_MOTOR
    bool "ESC motor backend"
    default y if DT_HAS_KABOT_ESC_ENABLED
    help
      Enables support for kabot,esc motor devices.

config KABOT_H_BRIDGE_MOTOR
    bool "H-bridge motor backend"
    default y if DT_HAS_KABOT_H_BRIDGE_ENABLED
    help
      Enables support for kabot,h-bridge motor devices.

config KABOT_SIM_MOTOR
    bool "Simulated motor backend"
    default y if DT_HAS_KABOT_SIM_MOTOR_ENABLED
    help
      Enables support for kabot,sim-motor motor devices.

config KABOT_MOTOR_SHELL
    bool "Motor shell commands"
    default y
    depends on SHELL
    help
      Enables the 'motor' shell command for manual control and listing.

config MOTOR_DRIVER_INIT_PRIORITY
    int "Motor driver init priority"
    default 55
    range 0 999
    help
      Initialization priority for motor driver devices.
      Must be greater than CONFIG_PWM_INIT_PRIORITY so motor drivers are
      initialized after PWM.

endif # MOTOR_DRIVER_MODULE
```

## modules/motor_driver/dts/bindings/kabot,h-bridge.yaml
```yaml
description: Generic dual-input H-bridge motor driver.

compatible: "kabot,h-bridge"

include: base.yaml

properties:
  pwms:
    required: true
    type: phandle-array
    description: Two PWM signals for H-bridge inputs in order [A, B].

  pwm-names:
    type: string-array
    description: Optional PWM names corresponding to [A, B].

  supply-gpios:
    type: phandle-array
    description: Optional supply or enable control GPIO for the H-bridge.
```

## west.yml
```yaml
manifest:
    remotes:
        - name: zephyrproject-rtos
          url-base: https://github.com/zephyrproject-rtos
        - name: kpochwala
          url-base: https://github.com/kpochwala/
        - name: sylvio-alves
          url-base: https://github.com/sylvioalves
    projects:
        - name: micro_ros_zephyr_module
          remote: kpochwala
          revision: libmicroros-only-jazzy
          path: deps/modules/micro_ros_zephyr_module

        - name: zephyr
          remote: sylvio-alves
          revision: feature/esp32-pcnt-driver-update
          clone-depth: 1
          import:
              path-prefix: deps
              name-blocklist:
                  - acpica
                  - babblesim_base
                  - babblesim_ext_2G4_channel_NtNcable
                  - babblesim_ext_2G4_channel_multiatt
                  - babblesim_ext_2G4_device_WLAN_actmod
                  - babblesim_ext_2G4_device_burst_interferer
                  - babblesim_ext_2G4_device_playback
                  - babblesim_ext_2G4_libPhyComv1
                  - babblesim_ext_2G4_modem_BLE_simple
                  - babblesim_ext_2G4_modem_magic
                  - babblesim_ext_2G4_phy_v1
                  - babblesim_ext_libCryptov1
                  - bsim
                  - cmsis
                  - cmsis-dsp
                  - cmsis-nn
                  - cmsis_6
                  - edtt
                  - fatfs
                  - hal_adi
                  - hal_afbr
                  - hal_ambiq
                  - hal_atmel
                  - hal_bouffalolab
                  # - hal_espressif
                  - hal_ethos_u
                  - hal_gigadevice
                  - hal_infineon
                  - hal_intel
                  - hal_microchip
                  - hal_nordic
                  - hal_nuvoton
                  - hal_nxp
                  - hal_openisa
                  - hal_quicklogic
                  - hal_renesas
                  - hal_rpi_pico
                  - hal_sifli
                  - hal_silabs
                  - hal_st
                  - hal_stm32
                  - hal_tdk
                  - hal_telink
                  - hal_ti
                  - hal_wch
                  - hal_wurthelektronik
                  - hal_xtensa
                  - hostap
                  - liblc3
                  - libmctp
                  - libmetal
                  - libsbc
                  - littlefs
                  - lora-basics-modem
                  - loramac-node
                  - lvgl
                  # - mbedtls
                  # - mcuboot
                  - mipi-sys-t
                  - nanopb
                  # - net-tools
                  - nrf_hw_models
                  - nrf_wifi
                  - open-amp
                  - openthread
                  - percepio
                  # - picolibc
                  - segger
                  - trusted-firmware-a
                  - trusted-firmware-m
                  - uoscore-uedhoc
                  - zcbor
```
